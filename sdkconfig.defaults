## sdkconfig.defaults
```kconfig
CONFIG_ESPTOOLPY_FLASHSIZE_16MB=y
CONFIG_PARTITION_TABLE_CUSTOM=y
CONFIG_PARTITION_TABLE_CUSTOM_FILENAME="rexa_single_app.csv"
CONFIG_PARTITION_TABLE_FILENAME="rexa_single_app.csv"
CONFIG_BT_ENABLED=y
CONFIG_BT_BLUEDROID_ENABLED=y
CONFIG_BT_CONTROLLER_ENABLED=y
CONFIG_BT_BLE_42_FEATURES_SUPPORTED=y
CONFIG_BT_BLE_50_FEATURES_SUPPORTED=n
CONFIG_LUA_MAXSTACK=8192
CONFIG_ESP_MAIN_TASK_STACK_SIZE=8192
CONFIG_PM_ENABLE=y
CONFIG_LUA_USE_PSRAM=y
CONFIG_SPIRAM=y
CONFIG_SPIRAM_MODE_OCT=y
CONFIG_SPIRAM_TYPE_AUTO=y
CONFIG_SPIRAM_USE_MALLOC=y
CONFIG_MBEDTLS_CERTIFICATE_BUNDLE=y
```
